## sdkconfig.defaults.esp32s3
```kconfig
CONFIG_ESPTOOLPY_FLASHSIZE_16MB=y
CONFIG_ESPTOOLPY_FLASHMODE_QIO=y

CONFIG_ESP_DEFAULT_CPU_FREQ_MHZ_240=y

CONFIG_SPIRAM=y
CONFIG_SPIRAM_MODE_OCT=y
CONFIG_SPIRAM_SPEED_80M=y
CONFIG_SPIRAM_MALLOC_ALWAYSINTERNAL=512
CONFIG_SPIRAM_MALLOC_RESERVE_INTERNAL=65536
CONFIG_SPIRAM_MEMTEST=n
CONFIG_MBEDTLS_EXTERNAL_MEM_ALLOC=y

CONFIG_ESP32S3_INSTRUCTION_CACHE_32KB=y
CONFIG_ESP32S3_DATA_CACHE_64KB=y
CONFIG_ESP32S3_DATA_CACHE_LINE_64B=y

CONFIG_SR_WN_WN9_NIHAOXIAOZHI_TTS=y

CONFIG_ESP_SYSTEM_EVENT_TASK_STACK_SIZE=4096

# Enable BLE provisioning defaults
CONFIG_BT_NIMBLE_ENABLED=y
CONFIG_WIFI_PROV_MANAGER_ENABLED=y
CONFIG_ENABLE_BLE_PROVISIONING=y
CONFIG_BLE_PROV_TIMEOUT_MIN=10
CONFIG_BT_BLUEDROID_ENABLED=n
```
